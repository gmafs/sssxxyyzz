## digital_read/Kconfig
```kconfig
menuconfig DRIVERS_DIGITAL_READ
	bool "digital_read"
	default n
	---help---
		Enable support for digital_read
```

## ssxxyyzz/special_serial/Kconfig
```kconfig
menuconfig DRIVERS_SPECIAL_SERIAL
	bool "special_serial"
	default n
	---help---
		Enable support for special_serial
```
